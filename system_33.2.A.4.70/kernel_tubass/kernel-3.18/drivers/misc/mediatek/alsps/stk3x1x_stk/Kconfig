## system_33.2.A.4.70/kernel_tubass/kernel-3.18/drivers/misc/mediatek/alsps/stk3x1x_stk/Kconfig
```kconfig
config MTK_STK3X1X_STK
	bool "STK3X1X for MediaTek package"
	default y

config PROXIMITY_DOUBLEWAVE2WAKE
	bool "Wakeup by proximity sensor"
	default n
	help
	This enabled the wake up service by proximity service.
```
